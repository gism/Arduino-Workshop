/*
 *  Modify from Row-Column Scanning an 8x8 LED matrix tutorial
 *  http://arduino-er.blogspot.com/
 */

 /*
  *  The 8x8 font is ported from
  *  https://github.com/dhepper/font8x8/blob/master/font8x8_basic.h
  */

#include <Arduino.h>
#include <Wire.h>
#include <ArduinoNunchuk.h>

#include <Adafruit_NeoPixel.h>
#include <avr/io.h>
#include <avr/pgmspace.h>

void draw(byte color, signed int brightness, byte x, byte y);
void updateDisplay();
void drawWall();
void setupChar();
void clearWall();
void doScrolling();

byte font[128][8] = {
    { 0x00, 0x00, 0x00, 0x00, 0x00, 0x00, 0x00, 0x00},   // U+0000 (nul)
    { 0x00, 0x00, 0x00, 0x00, 0x00, 0x00, 0x00, 0x00},   // U+0001
    { 0x00, 0x00, 0x00, 0x00, 0x00, 0x00, 0x00, 0x00},   // U+0002
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    { 0x00, 0x00, 0x00, 0x00, 0x00, 0x00, 0x00, 0x00}    // U+007F
};

long scrollPosition = 0;
int colorLeters = 0;
#define brick_count 7
const PROGMEM uint8_t brick_colors[brick_count]={
  0b00011111, //cyan
  0b10000010, //purple
  0b11111100, //yellow
  0b11101000, //orange?
  0b00000011, //blue
  0b00011100, //green
  0b11100000 //red
};

// 2-dimensional array of pixels:
int pixels[8][8];

char str[] = "01234567890abcdefghijklmnopqrstuvwxyzABCDEFGHIJKLMNOPQRSTUVWXYZ";

// char str[] = {
//   0x20, 0x21, 0x22, 0x23, 0x24, 0x25, 0x26, 0x27,
//   0x28, 0x29, 0x2A, 0x2B, 0x2C, 0x2D, 0x2E, 0x2F,
//   0x30, 0x31, 0x32, 0x33, 0x34, 0x35, 0x36, 0x37,
//   0x38, 0x39, 0x3A, 0x3B, 0x3C, 0x3D, 0x3E, 0x3F,
//   0x40, 0x41, 0x42, 0x43, 0x44, 0x45, 0x46, 0x47,
//   0x48, 0x49, 0x4A, 0x4B, 0x4C, 0x4D, 0x4E, 0x4F,
//   0x50, 0x51, 0x52, 0x53, 0x54, 0x55, 0x56, 0x57,
//   0x58, 0x59, 0x5A, 0x5B, 0x5C, 0x5D, 0x5E, 0x5F,
//   0x60, 0x61, 0x62, 0x63, 0x64, 0x65, 0x66, 0x67,
//   0x68, 0x69, 0x6A, 0x6B, 0x6C, 0x6D, 0x6E, 0x6F,
//   0x70, 0x71, 0x72, 0x73, 0x74, 0x75, 0x76, 0x77,
//   0x78, 0x79, 0x7A, 0x7B, 0x7C, 0x7D, 0x7E, 0x7F,
// };

int strLen = sizeof(str);
int ptrChar = 0;


#define LEDDATAPIN 2

//Display Settings
#define    FIELD_WIDTH 8
#define    FIELD_HEIGHT 16
#define FULL 255

// Define the RGB pixel array and controller functions,
Adafruit_NeoPixel strip = Adafruit_NeoPixel(FIELD_WIDTH*FIELD_HEIGHT, LEDDATAPIN, NEO_GRB + NEO_KHZ800);
byte wall[FIELD_WIDTH][FIELD_HEIGHT];

void setup() {

  Serial.begin(115200);
  Serial.println("--- Tetris LETTERS v0.0 ---");

  pinMode(LEDDATAPIN, OUTPUT); //LED strip
  //setupChar();
}

void loop() {

  int availableBytes = Serial.available();
  if (availableBytes>0){
    strLen = 0;
    for(int i=0; i<availableBytes; i++) {
      char a = Serial.read();
      if((a>=20)&&(a<=120)){
        str[strLen] = a;
        strLen++;
      }
    }
    ptrChar = 0;
    scrollPosition = 0;
  }

  updateDisplay();
  doScrolling();
  //drawWall();
  delay(120);
}

void doScrolling(){

  for(int k = FIELD_HEIGHT - 1; k > 0; k-- ){
    for(int j=0; j < FIELD_WIDTH; j++){
      wall[j][k] = wall[j][k-1];
    }
  }

  ptrChar = scrollPosition/8;
  byte charLine = 7 - (scrollPosition-(8 * ptrChar));
  char c = str[ptrChar];

  // Serial.print("Scroll:\t");
  // Serial.print(scrollPosition);
  // Serial.print("\tChar pos:\t");
  // Serial.print(ptrChar);
  // Serial.print("\tLine:\t");
  // Serial.print(charLine);
  // Serial.print("\tChar:\t");
  // Serial.print(c);
  // Serial.print('\t');
  // Serial.println(c,HEX);

  byte bitMask = 0x01;
  byte f = font[c][charLine];

  if((c == ' ') && (charLine == 0)){
    colorLeters++;
  }
  if (colorLeters > brick_count - 1){
    colorLeters = 0;
  }

  uint8_t color = pgm_read_byte(&(brick_colors[colorLeters]));

  for (int x = 0; x < 8; x++) {
    if (f & bitMask){
      Serial.print('O');
      wall[x][0] = color;
    }else{
      wall[x][0] = 0;
      Serial.print('.');
    }
    bitMask = bitMask << 1;
  }
  Serial.println('.');

  for( byte i = 0; i < FIELD_WIDTH; i++ ){
    for( byte k = 0; k < FIELD_HEIGHT; k++ ){
      draw(wall[i][k],FULL,i,k);
    }
  }

  scrollPosition++;
  if (scrollPosition > (strLen * 8) - 1){
    scrollPosition = 0;
  }
}


void setupChar(){
  char c = str[ptrChar];

  Serial.print(c);
  Serial.print('\t');
  Serial.println(c,HEX);

  if(c ==  ' '){
    colorLeters++;
  }

  for (int x = 0; x < 8; x++) {
    byte bitMask = 0x01;
    byte f = font[c][x];
    for (int y = 0; y < 8; y++) {
      if (f & bitMask){
        pixels[x][y] = LOW;
      }else{
        pixels[x][y] = HIGH;
      }
      bitMask = bitMask << 1;
    }
  }

  ptrChar++;
  if(ptrChar>=strLen){
    ptrChar = 0;
  }
}

//draws wall only, does not update display
void drawWall(){
  for(int j=0; j < 8; j++){
    for(int k = 0; k < 8; k++ )
    {
      int thisPixel = pixels[k][j];
      if (thisPixel == LOW) {
        uint8_t c = pgm_read_byte(&(brick_colors[colorLeters]));
        draw(c,FULL,j,k);
      }else{
        draw(0,FULL,j,k);
      }
    }
  }
}

//Update LED strips
void updateDisplay(){
  strip.show();
}

//takes a byte color values an draws it to pixel array at screen x,y values.
//new brightness value lets you dim LEDs w/o changing color.
void draw(byte color, signed int brightness, byte x, byte y){
  unsigned short address=0;
  byte r,g,b;

  //calculate address (LED position on strip)
  y = (FIELD_HEIGHT-1) - y;
  if (y % 2 != 0) x = (FIELD_WIDTH - 1) - x;

  address = x + y*8;

  if(color==0 || brightness < 0){
    strip.setPixelColor(address, 0);
  }
  else{
    //calculate colors, map to LED system
    b=color&0b00000011;
    g=(color&0b00011100)>>2;
    r=(color&0b11100000)>>5;

    //make sure brightness value is correct
    brightness=constrain(brightness,0,FULL);

    strip.setPixelColor(address, map(r,0,7,0,brightness), map(g,0,7,0,brightness), map(b,0,3,0,brightness));
  }
}

//clears the wall for a new game
void clearWall()
{
  for( byte i = 0; i < FIELD_WIDTH; i++ )
  {
    for( byte k = 0; k < FIELD_HEIGHT; k++ )
    {
      wall[i][k] = 0;
    }
  }
}
